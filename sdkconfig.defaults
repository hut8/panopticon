## sdkconfig.defaults
```kconfig
# Rust often needs a bit of extra main task stack size compared to C (default is 3K)
CONFIG_ESP_MAIN_TASK_STACK_SIZE=8000

# Enable WiFi
CONFIG_ESP_WIFI_ENABLED=y

# Use TLS certificate bundle for HTTPS
CONFIG_MBEDTLS_CERTIFICATE_BUNDLE=y
CONFIG_MBEDTLS_CERTIFICATE_BUNDLE_DEFAULT_FULL=y
```
